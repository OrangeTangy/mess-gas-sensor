## firmware/bme280_gateway/main/Kconfig.projbuild
```kconfig
menu "MESS BME280 gateway"
config MESS_GW_SSID
    string "Hotspot name"
    default "MESS-BME280"
config MESS_GW_PASSWORD
    string "Hotspot password (8..63 characters, required)"
    default ""
config MESS_GW_CHANNEL
    int "Wi-Fi channel"
    range 1 11
    default 6
endmenu
```

## firmware/bme280_serial/main/Kconfig.projbuild
```kconfig
menu "MESS BME280"
config MESS_BME_SDA
    int "I2C SDA GPIO"
    default 21
config MESS_BME_SCL
    int "I2C SCL GPIO"
    default 22
endmenu
```

## firmware/gas_sensor/main/Kconfig.projbuild
```kconfig
menu "MESS gas sensor"
config MESS_SDA
    int "SDA GPIO (verify your board)"
    default 21
config MESS_SCL
    int "SCL GPIO (verify your board)"
    default 22
config MESS_WIFI_SSID
    string "Wi-Fi SSID (empty = serial only)"
    default ""
config MESS_WIFI_PASSWORD
    string "Wi-Fi password"
    default ""
config MESS_SERVER_URL
    string "Laptop receiver URL"
    default "http://192.168.1.100:8000/readings"
config MESS_NTP_SERVER
    string "NTP server (empty disables clock sync and baseline persistence)"
    default "pool.ntp.org"
config MESS_MESH
    bool "Enable ESP-WIFI-MESH multi-hop transport"
    default n
config MESS_SENSOR_ENABLED
    bool "SGP30 fitted to this node (disable for relay-only node)"
    default y
config MESS_MESH_GROUP
    int "Gas team mesh group ID (same on every team node)"
    range 1 255
    default 4
    depends on MESS_MESH
config MESS_MESH_CHANNEL
    int "Router Wi-Fi channel (same on every node)"
    range 1 11
    default 6
    depends on MESS_MESH
config MESS_MESH_LAYERS
    int "Maximum mesh layers including root"
    range 2 10
    default 6
    depends on MESS_MESH
config MESS_MESH_PASSWORD
    string "Mesh link password (8..63 characters, set the same on all nodes)"
    default ""
    depends on MESS_MESH
endmenu
```

## firmware/gas_sensor/sdkconfig.defaults
```kconfig
CONFIG_FREERTOS_HZ=1000
CONFIG_ESP_MAIN_TASK_STACK_SIZE=6144
CONFIG_PARTITION_TABLE_SINGLE_APP_LARGE=y
```
